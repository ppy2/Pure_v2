## Config.in
```kconfig
source "$BR2_EXTERNAL_PURE_PATH/package/roonready/Config.in"
source "$BR2_EXTERNAL_PURE_PATH/package/naa/Config.in"
source "$BR2_EXTERNAL_PURE_PATH/package/aprenderer/Config.in"
source "$BR2_EXTERNAL_PURE_PATH/package/scream/Config.in"
source "$BR2_EXTERNAL_PURE_PATH/package/tidalconnect/Config.in"
source "$BR2_EXTERNAL_PURE_PATH/package/squeezeliteR2/Config.in"
source "$BR2_EXTERNAL_PURE_PATH/package/librespot/Config.in"
source "$BR2_EXTERNAL_PURE_PATH/package/botic7/Config.in"
```

## package/aprenderer/Config.in
```kconfig
config BR2_PACKAGE_APRENDERER
	bool "aprenderer"
        help
	  "UPNP aprenderer"
```

## package/botic7/Config.in
```kconfig
config BR2_PACKAGE_BOTIC7
	bool "botic7"
	
	help
	    Linux kernel v4.9 with Botic driver support.
	    http://bbb.ieero.com
```

## package/librespot/Config.in
```kconfig
config BR2_PACKAGE_LIBRESPOT
    bool "librespot"
    depends on BR2_PACKAGE_HOST_RUSTC_TARGET_ARCH_SUPPORTS
    select BR2_PACKAGE_HOST_RUSTC
    help
      This is a comment that explains what foo is.
      http://foosoftware.org/foo/
```

## package/scream/Config.in
```kconfig
config BR2_PACKAGE_SCREAM
	bool "scream"
        help
	    Scream is a virtual device driver for Windows that provides a discrete sound device. 
	    Audio played through this device is published on your local network as a PCM multicast stream.
```

## package/squeezeliteR2/Config.in
```kconfig
config BR2_PACKAGE_SQUEEZELITER2
	bool "squeezeliteR2"
        help
	  squeezeliteR2
```

## package/tidalconnect/Config.in
```kconfig
config BR2_PACKAGE_TIDALCONNECT
	bool "tidalconnect"
        help
	  TidalConnect UNIX daemon. 
```
